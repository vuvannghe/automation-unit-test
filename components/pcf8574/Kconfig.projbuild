## components/pcf8574/Kconfig.projbuild
```kconfig
menu "PCF8574 configuration"
    config PCF_PIN_NUM_SCL
        int "PCF SCL PIN Number"
        default 27
        help
            GPIO number for I2C Master clock line.

    config PCF_PIN_NUM_SDA
        int "PCF SDA PIN Number"
        default 26
        help
            GPIO number for I2C Master data line.

    config PCF_I2C_PORT
        int "I2C Port"
        default 0
        help 
            I2C port for IC PCF8574.

    config PCF_I2C_FREQ_HZ
        int "Frequency I2C"
        default 400000
        help
            I2C frequency.

endmenu
```
